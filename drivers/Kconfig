## west.yml
```yaml
manifest:
  defaults:
    remote: upstream

  remotes:
    - name: upstream
      url-base: https://github.com/zephyrproject-rtos

  projects:
    - name: zephyr
      revision: v3.7.0
      import:
        name-allowlist:
          - zephyr
          - hal_stm32
          - cmsis

  self:
    path: zephyr-custom-west
```
